## drivers/wifi/Kconfig
```kconfig
#
# Copyright (c) 2026 Nordic Semiconductor ASA
#
# SPDX-License-Identifier: LicenseRef-Nordic-5-Clause
#

if WIFI

rsource "nrf71/Kconfig"
rsource "nrf71_sim/Kconfig"
rsource "nrf92/Kconfig"

endif # WIFI
```

## drivers/wifi/nrf71_sim/Kconfig
```kconfig
# Copyright (c) 2026 Nordic Semiconductor ASA
# SPDX-License-Identifier: LicenseRef-Nordic-5-Clause

config WIFI_NRF71_SIM
	bool "Simulated nRF71 UMAC for native_sim"
	default y
	depends on DT_HAS_NORDIC_NRF71_SIM_IPC_ENABLED
	depends on ARCH_POSIX
	help
	  IPC service backend and UMAC model that let the nRF71 Wi-Fi
	  driver run on native_sim without hardware.

if WIFI_NRF71_SIM

module = WIFI_NRF71_SIM
module-str = nRF71 UMAC simulator
source "subsys/logging/Kconfig.template.log_config"

endif
```

## dts/bindings/ipc/nordic,nrf71-sim-ipc.yaml
```yaml
# Copyright (c) 2026 Nordic Semiconductor ASA
# SPDX-License-Identifier: LicenseRef-Nordic-5-Clause

description: Simulated nRF71 Wi-Fi core IPC instance for native_sim

compatible: "nordic,nrf71-sim-ipc"

include: base.yaml
```

## samples/net/aws_iot/boards/nrf7120dk_nrf7120_cpuapp.conf
```kconfig
#
# Copyright (c) 2026 Nordic Semiconductor ASA
#
# SPDX-License-Identifier: LicenseRef-Nordic-5-Clause
#

# Secure Storage provides persistent TLS credentials without TF-M.
CONFIG_SECURE_STORAGE=y
CONFIG_FLASH=y
CONFIG_ZMS=y
CONFIG_SETTINGS=y

# Bootloader and FOTA
CONFIG_BOOTLOADER_MCUBOOT=y
CONFIG_MCUBOOT_IMG_MANAGER=y
CONFIG_FLASH_MAP=y
CONFIG_IMG_MANAGER=y
CONFIG_STREAM_FLASH=y
CONFIG_IMG_ERASE_PROGRESSIVELY=y
CONFIG_AWS_FOTA=y
CONFIG_FOTA_DOWNLOAD=y
CONFIG_DFU_TARGET=y
CONFIG_DOWNLOADER=y
CONFIG_DOWNLOADER_STACK_SIZE=4096
```

## subsys/net/lib/connect_by_name/Kconfig
```kconfig
#
# Copyright (c) 2026 Nordic Semiconductor ASA
#
# SPDX-License-Identifier: LicenseRef-Nordic-5-Clause
#

menuconfig CONNECT_BY_NAME
	bool "Host address iterator"
	depends on NET_SOCKETS
	help
	  Resolve a host name and iterate over the addresses that are usable
	  now. The application connects to each address.

if CONNECT_BY_NAME

config CONNECT_BY_NAME_READINESS
	bool "Track connectivity readiness"
	depends on NET_CONNECTION_MANAGER
	default n if NRF_MODEM_LIB && !NRF_MODEM_LIB_NET_IF
	default y
	help
	  Track IPv4, IPv6 and DNS readiness through connection manager events.
	  Only families that are up are resolved and returned, and
	  connect_by_name_resolve() waits for the network to be ready. Disable
	  when no network interface reports these events.

config CONNECT_BY_NAME_MODEM_READINESS
	bool "Query the modem for readiness"
	depends on NRF_MODEM_LIB && NET_SOCKETS_OFFLOAD && !CONNECT_BY_NAME_READINESS
	default y
	help
	  Without readiness tracking, check the IP addresses of the modem's
	  default PDN with AT+CGPADDR. Only families that are up are resolved
	  and returned, and waiting for the network polls the modem.

config CONNECT_BY_NAME_MODEM_POLL_INTERVAL_MS
	int "Modem readiness poll interval (ms)"
	depends on CONNECT_BY_NAME_MODEM_READINESS
	default 1000
	help
	  How often the modem is queried while waiting.

module = CONNECT_BY_NAME
module-str = Host address iterator
source "subsys/logging/Kconfig.template.log_config"

endif # CONNECT_BY_NAME
```

## sysbuild/Kconfig.zip
```kconfig
# Copyright (c) 2024 Nordic Semiconductor
#
# SPDX-License-Identifier: LicenseRef-Nordic-5-Clause

menuconfig DFU_ZIP
	bool "Create DFU zip package"
	depends on BOOTLOADER_MCUBOOT || (SECURE_BOOT_APPCORE && SECURE_BOOT_BUILD_S1_VARIANT_IMAGE)
	depends on PARTITION_MANAGER
	default y
	help
	  Build DFU zip package that contains a manifest file and selected update images.

if DFU_ZIP

config DFU_ZIP_APP
	bool "Application update"
	default y
	help
	  Include application update in DFU zip.

if BOOTLOADER_MCUBOOT

config DFU_ZIP_NET
	bool "Network core update"
	depends on SUPPORT_NETCORE
	depends on !NETCORE_NONE
	depends on SECURE_BOOT_NETCORE
	depends on NETCORE_APP_UPDATE
	default y
	help
	  Include network-core update in DFU zip.

config DFU_ZIP_WIFI_FW_PATCH
	bool "nRF70 firmware patch"
	depends on PARTITION_MANAGER
	depends on WIFI_NRF70
	depends on (WIFI_PATCHES_EXT_FLASH_XIP || WIFI_PATCHES_EXT_FLASH_STORE)
	default y
	help
	  Include nRF7x firmware patch in DFU zip.

config DFU_ZIP_BLUETOOTH_MESH_METADATA
	bool "Bluetooth mesh metadata"
	help
	  Includes metadata for bluetooth mesh.

choice DFU_ZIP_BLUETOOTH_MESH_FWID
	prompt "FWID used for Metadata"
	default DFU_ZIP_BLUETOOTH_MESH_FWID_CUSTOM

config DFU_ZIP_BLUETOOTH_MESH_FWID_CUSTOM
	bool "Custom FWID"
	help
	  Any FWID used by app

config DFU_ZIP_BLUETOOTH_MESH_FWID_NCS_SAMPLES
	bool "Use sample's FWID"
	help
	  FWID format used by NCS samples

endchoice # DFU_ZIP_BLUETOOTH_MESH_FWID

if DFU_ZIP_BLUETOOTH_MESH_FWID_CUSTOM

config DFU_ZIP_BLUETOOTH_MESH_FWID_CUSTOM_HEX
	string "Custom FWID as hex string"
	help
	  Custom FWID as hex string

endif # DFU_ZIP_BLUETOOTH_MESH_FWID_CUSTOM

endif # BOOTLOADER_MCUBOOT

endif # DFU_ZIP
```

## tests/subsys/net/lib/device_key/testcase.yaml
```yaml
tests:
  net.lib.device_key:
    sysbuild: true
    platform_allow:
      - native_sim
    integration_platforms:
      - native_sim
    tags:
      - sysbuild
      - ci_tests_subsys_net
```
