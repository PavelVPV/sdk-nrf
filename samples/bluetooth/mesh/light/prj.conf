## prj.conf
```kconfig
#
# Copyright (c) 2019 Nordic Semiconductor ASA
#
# SPDX-License-Identifier: LicenseRef-Nordic-5-Clause
#
CONFIG_NCS_SAMPLES_DEFAULTS=y

# Deferred logging helps improve LPN power consumption
# when friendship is established.
CONFIG_LOG_MODE_DEFERRED=y

# General configuration
CONFIG_NCS_APPLICATION_BOOT_BANNER_STRING="Mesh Light"
CONFIG_SYSTEM_WORKQUEUE_STACK_SIZE=2048
CONFIG_FLASH=y
CONFIG_FLASH_MAP=y
CONFIG_NVS=y
CONFIG_SETTINGS=y
CONFIG_NVS_LOOKUP_CACHE=y
CONFIG_SETTINGS_NVS_NAME_CACHE=y
CONFIG_HWINFO=y
CONFIG_DK_LIBRARY=y
CONFIG_PM_SINGLE_IMAGE=y
CONFIG_PM_PARTITION_SIZE_SETTINGS_STORAGE=0x8000
CONFIG_SOC_FLASH_NRF_PARTIAL_ERASE=y

# Bluetooth configuration
CONFIG_BT=y
CONFIG_BT_DEVICE_NAME="Mesh Light"
CONFIG_BT_L2CAP_TX_BUF_COUNT=8

CONFIG_BT_OBSERVER=y
CONFIG_BT_PERIPHERAL=y
CONFIG_BT_SETTINGS=y
# Increase RX stack size to avoid overflow during provisioning
CONFIG_BT_RX_STACK_SIZE=2700

# Disable unused Bluetooth features
CONFIG_BT_CTLR_LE_ENC=n
CONFIG_BT_PHY_UPDATE=n
CONFIG_BT_CTLR_CHAN_SEL_2=n
CONFIG_BT_CTLR_MIN_USED_CHAN=n
CONFIG_BT_CTLR_PRIVACY=n

# Bluetooth Mesh configuration
CONFIG_BT_MESH=y
CONFIG_BT_MESH_RELAY=y
CONFIG_BT_MESH_FRIEND=y
CONFIG_BT_MESH_TX_SEG_MAX=10
CONFIG_BT_MESH_PB_GATT=y
CONFIG_BT_MESH_GATT_PROXY=y
CONFIG_BT_MESH_PROXY_USE_DEVICE_NAME=y
CONFIG_BT_MESH_DK_PROV=y

# Bluetooth Mesh models
CONFIG_BT_MESH_ONOFF_SRV=y

CONFIG_BT_MESH_MODEL_EXTENSIONS=y
CONFIG_BT_MESH_RPR_SRV=y
CONFIG_RESET_ON_FATAL_ERROR=n

CONFIG_SHELL=y

CONFIG_BT_RX_STACK_SIZE=3200

CONFIG_BT_MESH_TX_SEG_MSG_COUNT=3
```

## src/main.c
```c
/*
 * Copyright (c) 2019 Nordic Semiconductor ASA
 *
 * SPDX-License-Identifier: LicenseRef-Nordic-5-Clause
 */

/** @file
 *  @brief Nordic mesh light sample
 */
#include <zephyr/bluetooth/bluetooth.h>
#include <bluetooth/mesh/models.h>
#include <bluetooth/mesh/dk_prov.h>
#include <dk_buttons_and_leds.h>
#include "model_handler.h"
#include "smp_bt.h"

static void bt_ready(int err)
{
	if (err) {
		printk("Bluetooth init failed (err %d)\n", err);
		return;
	}

	printk("Bluetooth initialized\n");

	err = dk_leds_init();
	if (err) {
		printk("Initializing LEDs failed (err %d)\n", err);
		return;
	}

	err = dk_buttons_init(NULL);
	if (err) {
		printk("Initializing buttons failed (err %d)\n", err);
		return;
	}

	err = bt_mesh_init(bt_mesh_dk_prov_init(), model_handler_init());
	if (err) {
		printk("Initializing mesh failed (err %d)\n", err);
		return;
	}

	if (IS_ENABLED(CONFIG_SETTINGS)) {
		settings_load();
	}

	/* This will be a no-op if settings_load() loaded provisioning info */
	bt_mesh_prov_enable(BT_MESH_PROV_ADV | BT_MESH_PROV_GATT | BT_MESH_PROV_REMOTE);

	printk("Mesh initialized\n");

	if (IS_ENABLED(CONFIG_MCUMGR_TRANSPORT_BT)) {
		err = smp_dfu_init();
		if (err) {
			printk("Unable to initialize DFU (err %d)\n", err);
		}
	}
}

int main(void)
{
	int err;

	printk("Initializing...\n");

	err = bt_enable(bt_ready);
	if (err) {
		printk("Bluetooth init failed (err %d)\n", err);
	}

	return 0;
}
```

## src/model_handler.c
```c
/*
 * Copyright (c) 2019 Nordic Semiconductor ASA
 *
 * SPDX-License-Identifier: LicenseRef-Nordic-5-Clause
 */

#include <zephyr/shell/shell.h>
#include <zephyr/bluetooth/bluetooth.h>
#include <bluetooth/mesh/models.h>
#include <dk_buttons_and_leds.h>
#include "model_handler.h"

static void led_set(struct bt_mesh_onoff_srv *srv, struct bt_mesh_msg_ctx *ctx,
		    const struct bt_mesh_onoff_set *set,
		    struct bt_mesh_onoff_status *rsp);

static void led_get(struct bt_mesh_onoff_srv *srv, struct bt_mesh_msg_ctx *ctx,
		    struct bt_mesh_onoff_status *rsp);

static const struct bt_mesh_onoff_srv_handlers onoff_handlers = {
	.set = led_set,
	.get = led_get,
};

struct led_ctx {
	struct bt_mesh_onoff_srv srv;
	struct k_work_delayable work;
	uint32_t remaining;
	bool value;
};

static struct led_ctx led_ctx[] = {
#if DT_NODE_EXISTS(DT_ALIAS(led0))
	{ .srv = BT_MESH_ONOFF_SRV_INIT(led_ctx[0].srv, &onoff_handlers) },
#endif
#if DT_NODE_EXISTS(DT_ALIAS(led1))
	{ .srv = BT_MESH_ONOFF_SRV_INIT(led_ctx[1].srv, &onoff_handlers) },
#endif
#if DT_NODE_EXISTS(DT_ALIAS(led2))
	{ .srv = BT_MESH_ONOFF_SRV_INIT(led_ctx[2].srv, &onoff_handlers) },
#endif
#if DT_NODE_EXISTS(DT_ALIAS(led3))
	{ .srv = BT_MESH_ONOFF_SRV_INIT(led_ctx[3].srv, &onoff_handlers) },
#endif
};

static void led_transition_start(struct led_ctx *led)
{
	int led_idx = led - &led_ctx[0];

	/* As long as the transition is in progress, the onoff
	 * state is "on":
	 */
	dk_set_led(led_idx, true);
	k_work_reschedule(&led->work, K_MSEC(led->remaining));
	led->remaining = 0;
}

static void led_status(struct led_ctx *led, struct bt_mesh_onoff_status *status)
{
	/* Do not include delay in the remaining time. */
	status->remaining_time = led->remaining ? led->remaining :
		k_ticks_to_ms_ceil32(k_work_delayable_remaining_get(&led->work));
	status->target_on_off = led->value;
	/* As long as the transition is in progress, the onoff state is "on": */
	status->present_on_off = led->value || status->remaining_time;
}

static void led_set(struct bt_mesh_onoff_srv *srv, struct bt_mesh_msg_ctx *ctx,
		    const struct bt_mesh_onoff_set *set,
		    struct bt_mesh_onoff_status *rsp)
{
	struct led_ctx *led = CONTAINER_OF(srv, struct led_ctx, srv);
	int led_idx = led - &led_ctx[0];

	if (set->on_off == led->value) {
		goto respond;
	}

	led->value = set->on_off;
	if (!bt_mesh_model_transition_time(set->transition)) {
		led->remaining = 0;
		dk_set_led(led_idx, set->on_off);
		goto respond;
	}

	led->remaining = set->transition->time;

	if (set->transition->delay) {
		k_work_reschedule(&led->work, K_MSEC(set->transition->delay));
	} else {
		led_transition_start(led);
	}

respond:
	if (rsp) {
		led_status(led, rsp);
	}
}

static void led_get(struct bt_mesh_onoff_srv *srv, struct bt_mesh_msg_ctx *ctx,
		    struct bt_mesh_onoff_status *rsp)
{
	struct led_ctx *led = CONTAINER_OF(srv, struct led_ctx, srv);

	led_status(led, rsp);
}

static void led_work(struct k_work *work)
{
	struct led_ctx *led = CONTAINER_OF(work, struct led_ctx, work.work);
	int led_idx = led - &led_ctx[0];

	if (led->remaining) {
		led_transition_start(led);
	} else {
		dk_set_led(led_idx, led->value);

		/* Publish the new value at the end of the transition */
		struct bt_mesh_onoff_status status;

		led_status(led, &status);
		bt_mesh_onoff_srv_pub(&led->srv, NULL, &status);
	}
}

/* Set up a repeating delayed work to blink the DK's LEDs when attention is
 * requested.
 */
static struct k_work_delayable attention_blink_work;
static bool attention;

static void attention_blink(struct k_work *work)
{
	static int idx;
	const uint8_t pattern[] = {
#if DT_NODE_EXISTS(DT_ALIAS(led0))
		BIT(0),
#endif
#if DT_NODE_EXISTS(DT_ALIAS(led1))
		BIT(1),
#endif
#if DT_NODE_EXISTS(DT_ALIAS(led2))
		BIT(2),
#endif
#if DT_NODE_EXISTS(DT_ALIAS(led3))
		BIT(3),
#endif
	};

	if (attention) {
		dk_set_leds(pattern[idx++ % ARRAY_SIZE(pattern)]);
		k_work_reschedule(&attention_blink_work, K_MSEC(30));
	} else {
		dk_set_leds(DK_NO_LEDS_MSK);
	}
}

static void attention_on(const struct bt_mesh_model *mod)
{
	attention = true;
	k_work_reschedule(&attention_blink_work, K_NO_WAIT);
}

static void attention_off(const struct bt_mesh_model *mod)
{
	/* Will stop rescheduling blink timer */
	attention = false;
}

static const struct bt_mesh_health_srv_cb health_srv_cb = {
	.attn_on = attention_on,
	.attn_off = attention_off,
};

static struct bt_mesh_health_srv health_srv = {
	.cb = &health_srv_cb,
};

BT_MESH_HEALTH_PUB_DEFINE(health_pub, 0);

static struct bt_mesh_elem elements[] = {
#if DT_NODE_EXISTS(DT_ALIAS(led0))
	BT_MESH_ELEM(
		1, BT_MESH_MODEL_PTR_LIST(
			BT_MESH_MODEL_DECLARE(BT_MESH_MODEL_CFG_SRV),
			BT_MESH_MODEL_DECLARE(BT_MESH_MODEL_HEALTH_SRV(&health_srv, &health_pub)),
			BT_MESH_MODEL_DECLARE(BT_MESH_MODEL_RPR_SRV),
			BT_MESH_MODEL_ONOFF_SRV(&led_ctx[0].srv)),
		BT_MESH_MODEL_PTR_LIST()),
#endif
#if DT_NODE_EXISTS(DT_ALIAS(led1))
	BT_MESH_ELEM(
		2, ((const struct bt_mesh_model *[]) {
			BT_MESH_MODEL_ONOFF_SRV(&led_ctx[1].srv)}),
		(const struct bt_mesh_model *[]) {  }),
#endif
#if DT_NODE_EXISTS(DT_ALIAS(led2))
	BT_MESH_ELEM(
		3, ((const struct bt_mesh_model *[]) {
			BT_MESH_MODEL_ONOFF_SRV(&led_ctx[2].srv)}),
		(const struct bt_mesh_model *[]) { }),
#endif
#if DT_NODE_EXISTS(DT_ALIAS(led3))
	BT_MESH_ELEM(
		4, ((const struct bt_mesh_model *[]) {
			BT_MESH_MODEL_ONOFF_SRV(&led_ctx[3].srv)}),
		(const struct bt_mesh_model *[]) {  }),
#endif
};

#define COMP_DECLARE(_elem_count) \
	{ \
		.cid = CONFIG_BT_COMPANY_ID, \
		.elem = elements, \
		.elem_count = _elem_count, \
	}

static const struct bt_mesh_comp comps[] = {
	COMP_DECLARE(1), COMP_DECLARE(2), COMP_DECLARE(3), COMP_DECLARE(4)
};

static uint8_t leds_comp;

static int leds_load_cb(const char *name, size_t len_rd, settings_read_cb read_cb, void *cb_arg,
			void *param)
{
	static bool leds_loaded;

	if (leds_loaded) {
		return 0; // Already loaded
	}

	ssize_t len;

	len = read_cb(cb_arg, &leds_comp, sizeof(leds_comp));
	if (len < 0) {
		printk("Failed to read value (err %zd)", len);
		return len;
	}

	printk("Loaded LEDs: %d\n", leds_comp + 1);

	if (len != len_rd) {
		printk("Unexpected value length (%zd != %zu)", len, len_rd);
		return -EINVAL;
	}

	leds_loaded = true;

	return 0;
}

const struct bt_mesh_comp *model_handler_init(void)
{
	int err;

	k_work_init_delayable(&attention_blink_work, attention_blink);

	for (int i = 0; i < ARRAY_SIZE(led_ctx); ++i) {
		k_work_init_delayable(&led_ctx[i].work, led_work);
	}

	err = settings_load_subtree_direct("app/leds", leds_load_cb, NULL);
	if (err) {
		printk("Failed to load LED settings (err %d)\n", err);
		return &comps[0];
	}

	return &comps[leds_comp];
}

static void comp_reg_and_store_handler(struct k_work *work)
{
	int err;

	printk("LEDs supported: %d\n", leds_comp + 1);

	/* FIXME: This doesn't handle the case when reboot happens before reprovisioning.
	 * In this case, the old composition data should be passed.
	 */
	err = bt_mesh_comp128_register(&comps[leds_comp]);
	if (err) {
		printk("Failed to register LED component (err %d)\n", err);
		return;
	}

	err = settings_save_one("app/leds", &leds_comp, sizeof(leds_comp));
	if (err) {
		printk("Failed to save LED settings (err %d)\n", err);
		return;
	}
}

static K_WORK_DEFINE(comp_reg_and_store, comp_reg_and_store_handler);

static int cmd_led_add(const struct shell *shell, size_t argc, char *argv[])
{
	if (leds_comp >= ARRAY_SIZE(comps)) {
		shell_error(shell, "Maximum number of LEDs reached");
		return -ENOMEM;
	}

	leds_comp++;
	k_work_submit(&comp_reg_and_store);

	return 0;
}

static int cmd_led_remove(const struct shell *shell, size_t argc, char *argv[])
{
	if (leds_comp == 0) {
		shell_error(shell, "Maximum number of LEDs reached");
		return -ENOMEM;
	}

	leds_comp--;
	k_work_submit(&comp_reg_and_store);

	return 0;
}

SHELL_STATIC_SUBCMD_SET_CREATE(app_cmds,
	SHELL_CMD_ARG(led_add, NULL, "Add led", cmd_led_add, 1, 0),
	SHELL_CMD_ARG(led_remove, NULL, "Remove led", cmd_led_remove, 1, 0),

	SHELL_SUBCMD_SET_END
);

static int cmd_app(const struct shell *shell, size_t argc, char **argv)
{
	if (argc == 1) {
		shell_help(shell);
		/* shell returns 1 when help is printed */
		return 1;
	}

	shell_error(shell, "%s unknown parameter: %s", argv[0], argv[1]);

	return -EINVAL;
}

SHELL_CMD_ARG_REGISTER(app, &app_cmds, "App commands", cmd_app, 1, 1);
```

## src/smp_dfu.c
```c
/*
 * Copyright (c) 2022 Nordic Semiconductor ASA
 *
 * SPDX-License-Identifier: LicenseRef-Nordic-5-Clause
 */

#include <zephyr/init.h>

#include <img_mgmt/img_mgmt.h>
#include <os_mgmt/os_mgmt.h>
#include <zephyr/mgmt/mcumgr/smp_bt.h>

/* .. include_startingpoint_light_smp_dfu_rst_1 */
#include <zephyr/bluetooth/bluetooth.h>
#include <zephyr/bluetooth/conn.h>

static void pending_adv_start(struct k_work *work);

static struct bt_le_ext_adv *adv;
/* This will result in the device advertising SMP service continuously. If this is undesirable,
 * set timeout to a finite value, and then create a mechanism in the application (e.g. by pressing
 * a button) to start SMP advertisements when needed by calling @ref bt_le_ext_adv_start.
 */
static struct bt_le_ext_adv_start_param ext_adv_param = { .num_events = 0, .timeout = 0 };
static struct k_work_delayable adv_work = Z_WORK_DELAYABLE_INITIALIZER(pending_adv_start);

static struct bt_le_adv_param adv_params = {
	.id = BT_ID_DEFAULT,
	.sid = 0,
	.secondary_max_skip = 0,
	.options = BT_LE_ADV_OPT_CONNECTABLE | BT_LE_ADV_OPT_USE_NAME,
	.interval_min = BT_GAP_ADV_SLOW_INT_MIN,
	.interval_max = BT_GAP_ADV_SLOW_INT_MAX,
	.peer = NULL
};

static const struct bt_data ad[] = {
	BT_DATA_BYTES(BT_DATA_FLAGS, (BT_LE_AD_GENERAL | BT_LE_AD_NO_BREDR)),
	BT_DATA_BYTES(BT_DATA_UUID128_ALL, 0x84, 0xaa, 0x60, 0x74, 0x52, 0x8a, 0x8b, 0x86, 0xd3,
		      0x4c, 0xb7, 0x1d, 0x1d, 0xdc, 0x53, 0x8d),
};

static void pending_adv_start(struct k_work *work)
{
	int err;

	err = bt_le_ext_adv_start(adv, &ext_adv_param);
	if (err) {
		printk("Unable to restart SMP service advertising (err %d)\n", err);
		return;
	}

	printk("SMP service advertising restarted\n");
}

static void connected(struct bt_conn *conn, uint8_t err)
{
	struct bt_conn_info cinfo;
	int ec;

	ec = bt_conn_get_info(conn, &cinfo);
	if (ec) {
		printk("Unable to get connection info (err %d)\n", ec);
		return;
	}

	if (cinfo.id != adv_params.id) {
		return;
	}

	printk("Connected to SMP service: err %d id %d\n", err, cinfo.id);
}

static void disconnected(struct bt_conn *conn, uint8_t reason)
{
	int err;
	struct bt_conn_info cinfo;

	err = bt_conn_get_info(conn, &cinfo);
	if (err) {
		printk("Unable to get connection info (err %d)\n", err);
		return;
	}

	if (cinfo.id != adv_params.id) {
		return;
	}

	printk("Disconnected from SMP service: reason %d id %d\n", reason, cinfo.id);

	k_work_schedule(&adv_work, K_NO_WAIT);
}

static struct bt_conn_cb conn_callbacks = {
	.connected = connected,
	.disconnected = disconnected,
};

int smp_service_adv_init(void)
{
	int err;
	size_t id_count = 0xFF;
	int id;

	/* Use different identity from Bluetooth mesh to avoid conflicts with Mesh Provisioning
	 * Service and Mesh Proxy Service advertisements.
	 */
	bt_id_get(NULL, &id_count);

	if (id_count < CONFIG_BT_ID_MAX) {
		id = bt_id_create(NULL, NULL);
		if (id < 0) {
			printk("Unable to create a new identity for SMP (err %d)."
			       " Using the default one.\n", id);
			id = BT_ID_DEFAULT;
		}

		printk("Created a new identity for SMP: %d\n", id);
	} else {
		id = BT_ID_DEFAULT + 1;
		printk("Recovered identity for SMP: %d\n", id);
	}

	adv_params.id = id;

	err = bt_le_ext_adv_create(&adv_params, NULL, &adv);
	if (err) {
		printk("Creating SMP service adv instance failed (err %d)\n", err);
		return err;
	}

	err = bt_le_ext_adv_set_data(adv, ad, ARRAY_SIZE(ad), NULL, 0);
	if (err) {
		printk("Setting SMP service adv data failed (err %d)\n", err);
		return err;
	}

	err = bt_le_ext_adv_start(adv, &ext_adv_param);
	if (err) {
		printk("Starting advertising of SMP service failed (err %d)\n", err);
	}

	return err;
}
/* .. include_endpoint_light_smp_dfu_rst_1 */

int smp_dfu_init(void)
{
	int err;

	img_mgmt_register_group();
	os_mgmt_register_group();

	err = smp_bt_register();

	if (err) {
		printk("SMP BT service registration failed (err %d)\n", err);
		return err;
	}

/* .. include_startingpoint_light_smp_dfu_rst_2 */
	bt_conn_cb_register(&conn_callbacks);

	/**
	 * Since Bluetooth mesh utilizes the advertiser as the main channel of
	 * communication, a secondary advertising set is necessary to broadcast
	 * the SMP service.
	 */
	err = smp_service_adv_init();
/* .. include_endpoint_light_smp_dfu_rst_2 */
	return err;
}
```
