## CMakeLists.txt
```
#
# Copyright (c) 2020 Nordic Semiconductor
#
# SPDX-License-Identifier: LicenseRef-Nordic-5-Clause
#

cmake_minimum_required(VERSION 3.20.0)

find_package(Zephyr REQUIRED HINTS $ENV{ZEPHYR_BASE})
project(MOSH)
target_include_directories(app PRIVATE
  ${CMAKE_CURRENT_SOURCE_DIR}/src
  ${CMAKE_CURRENT_SOURCE_DIR}/iperf
  ${CMAKE_CURRENT_SOURCE_DIR}/ping
  ${CMAKE_CURRENT_SOURCE_DIR}/utils
  ${CMAKE_CURRENT_SOURCE_DIR}/link)

target_sources(app PRIVATE src/main.c)
target_sources(app PRIVATE src/shell.c)

add_subdirectory(src/print)
add_subdirectory(src/utils)
add_subdirectory(src/uart)
add_subdirectory(src/at)
add_subdirectory_ifdef(CONFIG_MOSH_NRF91_NON_OFFLOADING_DEV src/drivers)
add_subdirectory_ifdef(CONFIG_MOSH_WORKER_THREADS src/th)
add_subdirectory_ifdef(CONFIG_MOSH_SOCK src/sock)
add_subdirectory_ifdef(CONFIG_MOSH_LINK src/link)
add_subdirectory_ifdef(CONFIG_MOSH_PING src/ping)
add_subdirectory_ifdef(CONFIG_MOSH_GNSS src/gnss)
add_subdirectory_ifdef(CONFIG_MOSH_SMS src/sms)
add_subdirectory_ifdef(CONFIG_MOSH_LOCATION src/location)
add_subdirectory_ifdef(CONFIG_MOSH_PPP src/ppp)
add_subdirectory_ifdef(CONFIG_MOSH_FOTA src/fota)
add_subdirectory_ifdef(CONFIG_MOSH_REST src/rest)
add_subdirectory_ifdef(CONFIG_MOSH_STARTUP_CMDS src/startup_cmd)
add_subdirectory_ifdef(CONFIG_NRF_MODEM_LIB_TRACE src/modem_trace)
add_subdirectory(src/cloud)


add_subdirectory(src/mesh)

zephyr_include_directories_ifdef(CONFIG_MEMFAULT config)

if(NOT ENV{PROJECT_NAME})
  zephyr_compile_definitions(
    PROJECT_NAME=${CMAKE_PROJECT_NAME}
  )
endif()
```

## prj.conf
```kconfig
#
# Copyright (c) 2020 Nordic Semiconductor ASA
#
# SPDX-License-Identifier: LicenseRef-Nordic-5-Clause
#
# General config

CONFIG_MOSH_IPERF3=n
CONFIG_MOSH_SOCK=n
CONFIG_MOSH_PING=n
CONFIG_MOSH_CURL=n
CONFIG_MOSH_LINK=n
CONFIG_MOSH_SMS=n
CONFIG_MOSH_GNSS=n
CONFIG_MOSH_LOCATION=n
CONFIG_MOSH_FOTA=n

# Stacks and heaps
CONFIG_MAIN_STACK_SIZE=4096
CONFIG_HEAP_MEM_POOL_SIZE=8192

# System queue is used e.g. by AT monitor and SMS lib
CONFIG_SYSTEM_WORKQUEUE_STACK_SIZE=2048

# Shell configurations
CONFIG_SHELL=y
CONFIG_SHELL_WILDCARD=n
CONFIG_SHELL_PROMPT_UART="mosh:~$ "
CONFIG_SHELL_ARGC_MAX=40
# -h and --help options are handled in Modem Shell
CONFIG_SHELL_HELP_OPT_PARSE=n
# Command line buffer is set this large to enable writing of certificates and injecting A-GNSS data on command line.
CONFIG_SHELL_CMD_BUFF_SIZE=3584
# Shell stack has impact for modem shell application, not CONFIG_MAIN_STACK_SIZE
CONFIG_SHELL_STACK_SIZE=9216
# Shell RX buffer needs to be increased to avoid problems with test automation
CONFIG_SHELL_BACKEND_SERIAL_RX_RING_BUFFER_SIZE=512
# LTE shell is unnecessary with Modem Shell
CONFIG_LTE_SHELL=n
# Enable use of vsnprintfcb() for extending mosh_print() format
CONFIG_CBPRINTF_LIBC_SUBSTS=y

CONFIG_MINIMAL_LIBC=n
CONFIG_NEWLIB_LIBC=y
CONFIG_NEWLIB_LIBC_FLOAT_SCANF=n
CONFIG_NEWLIB_LIBC_FLOAT_PRINTF=y
CONFIG_FPU=y
CONFIG_CJSON_LIB=y

# Getopt
CONFIG_GETOPT_LIB=y
# Need to disable devmem shell since it enforces Zephyr's internal version of getopt
CONFIG_DEVMEM_SHELL=n

# Device power management
CONFIG_PM_DEVICE=y

# Modem info
CONFIG_MODEM_INFO=y

# Modem key management
CONFIG_MODEM_KEY_MGMT=y

# Network
CONFIG_NETWORKING=y
CONFIG_NET_NATIVE=n
CONFIG_NET_SOCKETS=y
CONFIG_NET_SOCKETS_OFFLOAD=y
CONFIG_NET_SOCKETS_POSIX_NAMES=n
# Native IPv6 is enabled by default, disable it because we don't need it
CONFIG_NET_IPV6=n

CONFIG_POSIX_API=y
CONFIG_PTHREAD_IPC=n # There are issues with posix api if this is set
CONFIG_POSIX_MAX_FDS=10
# Need to be the same as MAX_FDS
CONFIG_NET_SOCKETS_POLL_MAX=10

# Modem library
CONFIG_NRF_MODEM_LIB=y
CONFIG_NRF_MODEM_LIB_SHMEM_TX_SIZE=22528
CONFIG_NRF_MODEM_LIB_SHMEM_RX_SIZE=8192
CONFIG_NRF_MODEM_LIB_ON_FAULT_APPLICATION_SPECIFIC=y

# AT monitor library
CONFIG_AT_MONITOR=y

# Increase AT monitor heap because %NCELLMEAS notifications can be long.
# Note: with legacy NCELLMEAS types, 512 is enough, but with GCI search types
# it could be even longer: theoretical maximum of 4020 bytes.
CONFIG_AT_MONITOR_HEAP_SIZE=1024

# PDN library
CONFIG_PDN=y
CONFIG_PDN_ESM_STRERROR=y

# SMS
CONFIG_SMS=n

# LTE link control
CONFIG_LTE_LINK_CONTROL=y
# Use modem system mode setting by default.
CONFIG_LTE_NETWORK_MODE_DEFAULT=y

CONFIG_LTE_NETWORK_USE_FALLBACK=n

#MOSH is having own commands to enable these at runtime:
CONFIG_LTE_LC_MODEM_SLEEP_NOTIFICATIONS=n
CONFIG_LTE_LC_TAU_PRE_WARNING_NOTIFICATIONS=n

#Minimum values for thresholds:
CONFIG_LTE_LC_TAU_PRE_WARNING_THRESHOLD_MS=10240
CONFIG_LTE_LC_MODEM_SLEEP_NOTIFICATIONS_THRESHOLD_MS=10240

# Configurations useful for debugging and development that user can enable when needed
#CONFIG_LTE_LOCK_PLMN=y
#CONFIG_LTE_LOCK_PLMN_STRING="24488"
#CONFIG_LTE_NETWORK_MODE_LTE_M_GPS=y

CONFIG_DATE_TIME=n

# nRF Cloud A-GNSS, disable this in case you want to enable SUPL below
CONFIG_NRF_CLOUD_AGNSS=y

# SUPL A-GNSS support, needs the nRF9160 SiP SUPL client library from nRF9160 DK product page
#CONFIG_SUPL_CLIENT_LIB=y

# Cellular positioning
CONFIG_LTE_NEIGHBOR_CELLS_MAX=17

# Cellular positioning services
#CONFIG_LOCATION_SERVICE_NRF_CLOUD=n
#CONFIG_LOCATION_SERVICE_HERE=y
#CONFIG_LOCATION_SERVICE_HERE_API_KEY=""

# Library for buttons and LEDs
CONFIG_DK_LIBRARY=y

# FOTA
CONFIG_FLASH=y
CONFIG_REBOOT=y
CONFIG_DFU_TARGET=y
CONFIG_FOTA_DOWNLOAD=y
CONFIG_DOWNLOAD_CLIENT=y
# BOOTLOADER_MCUBOOT reduces usable flash size by half so it's disabled by default
# This means application FOTA is disabled. Modem FOTA works without these.
CONFIG_BOOTLOADER_MCUBOOT=n
CONFIG_IMG_MANAGER=n
CONFIG_IMG_ERASE_PROGRESSIVELY=n

# Settings
CONFIG_FLASH=y
CONFIG_FLASH_SHELL=n
CONFIG_FLASH_MAP=y
CONFIG_MPU_ALLOW_FLASH_WRITE=y
CONFIG_NVS=y
CONFIG_SETTINGS=y
CONFIG_SETTINGS_NVS=y
CONFIG_NVS_LOG_LEVEL_WRN=y

# Debugging configurations
CONFIG_ASSERT=y
CONFIG_LOG=y
# Keep printk() synchronous
CONFIG_LOG_PRINTK=n
CONFIG_DEBUG_INFO=y
#CONFIG_DEBUG_OPTIMIZATIONS=y
#CONFIG_NO_OPTIMIZATIONS=y
#CONFIG_FORCE_NO_ASSERT=y
CONFIG_ASSERT_VERBOSE=y
#CONFIG_ASSERT_LEVEL=2
#CONFIG_ASSERT_ON_ERRORS=y
#CONFIG_FAULT_DUMP=2
CONFIG_RESET_ON_FATAL_ERROR=n
CONFIG_EXTRA_EXCEPTION_INFO=y
#CONFIG_WATCHDOG=y
CONFIG_SYS_HEAP_RUNTIME_STATS=y
# Enable TF-M logging on UART0
CONFIG_TFM_SECURE_UART0=y
CONFIG_TFM_LOG_LEVEL_SILENCE=n
CONFIG_TFM_EXCEPTION_INFO_DUMP=y
CONFIG_TFM_SPM_LOG_LEVEL_DEBUG=n
```

## overlay-bt-orig.conf
```kconfig
# Disable Modem traces
CONFIG_NRF_MODEM_LIB_TRACE=n
CONFIG_TFM_SECURE_UART1=n

#UART2 towards nRF52840
CONFIG_UART_INTERRUPT_DRIVEN=y
CONFIG_NRF_SW_LPUART=y
CONFIG_NRF_SW_LPUART_INT_DRIVEN=y
CONFIG_UART_2_ASYNC=y
CONFIG_UART_2_INTERRUPT_DRIVEN=n
CONFIG_UART_2_NRF_HW_ASYNC=y
CONFIG_UART_2_NRF_HW_ASYNC_TIMER=2

CONFIG_BT=y
CONFIG_BT_DEVICE_NAME="mosh"
CONFIG_BT_DEVICE_NAME_DYNAMIC=y

CONFIG_BT_H4=y
CONFIG_BT_HCI=y

CONFIG_BT_BROADCASTER=y
CONFIG_BT_OBSERVER=y

CONFIG_BT_DEBUG_NONE=y
#CONFIG_BT_DEBUG_LOG=y
CONFIG_BT_LOG_LEVEL_OFF=y
#CONFIG_BT_DEBUG_HCI_CORE=y
#CONFIG_BT_SHELL=y

# Heap and stacks
CONFIG_SYSTEM_WORKQUEUE_STACK_SIZE=4096
CONFIG_MAIN_STACK_SIZE=8192

CONFIG_BT_MESH=y
CONFIG_BT_MESH_USES_TINYCRYPT=y
```

## overlay-bt.conf
```kconfig
# Disable Modem traces
CONFIG_NRF_MODEM_LIB_TRACE=n
CONFIG_TFM_SECURE_UART1=n

#UART2 towards nRF52840
CONFIG_UART_INTERRUPT_DRIVEN=y
CONFIG_NRF_SW_LPUART=y
CONFIG_NRF_SW_LPUART_INT_DRIVEN=y
CONFIG_UART_2_ASYNC=y
CONFIG_UART_2_INTERRUPT_DRIVEN=n
CONFIG_UART_2_NRF_HW_ASYNC=y
CONFIG_UART_2_NRF_HW_ASYNC_TIMER=2

CONFIG_BT=y
CONFIG_BT_DEVICE_NAME="mosh"
CONFIG_BT_DEVICE_NAME_DYNAMIC=n

CONFIG_BT_H4=y
CONFIG_BT_HCI=y

#CONFIG_BT_BROADCASTER=y
CONFIG_BT_OBSERVER=y

CONFIG_BT_PERIPHERAL=y
CONFIG_BT_BUF_EVT_RX_SIZE=255
CONFIG_BT_BUF_EVT_RX_COUNT=10
CONFIG_BT_BUF_EVT_DISCARDABLE_SIZE=58
CONFIG_BT_BUF_CMD_TX_SIZE=255

CONFIG_BT_HOST_CRYPTO=y
CONFIG_BT_HOST_CRYPTO_PRNG=y


CONFIG_BT_DEBUG_NONE=y
#CONFIG_BT_DEBUG_LOG=y
CONFIG_BT_LOG_LEVEL_OFF=y
#CONFIG_BT_DEBUG_HCI_CORE=y
#CONFIG_BT_SHELL=y

# Heap and stacks
CONFIG_SYSTEM_WORKQUEUE_STACK_SIZE=4096
CONFIG_MAIN_STACK_SIZE=8192

####################################################################################################
# Mesh Distributor config
####################################################################################################
# Mesh Distributor config

CONFIG_DK_LIBRARY=y

# Bluetooth configuration
CONFIG_BT_L2CAP_TX_BUF_COUNT=8
CONFIG_BT_SETTINGS=y
CONFIG_BT_ECC=n
#CONFIG_BT_TINYCRYPT_ECC=y

# Disable unused Bluetooth features
CONFIG_BT_CTLR_DUP_FILTER_LEN=0
CONFIG_BT_CTLR_LE_ENC=n
CONFIG_BT_DATA_LEN_UPDATE=n
CONFIG_BT_PHY_UPDATE=n
CONFIG_BT_CTLR_CHAN_SEL_2=n
CONFIG_BT_CTLR_PRIVACY=n
CONFIG_BT_CTLR_PHY_2M=n
CONFIG_BT_MESH=y
#
# Bluetooth mesh configuration
CONFIG_BT_MESH=y
CONFIG_BT_MESH_USES_TINYCRYPT=y
CONFIG_BT_MESH_V1d1=y
CONFIG_BT_MESH_RELAY=y
CONFIG_BT_MESH_MSG_CACHE_SIZE=256
CONFIG_BT_MESH_ADV_BUF_COUNT=128
CONFIG_BT_MESH_TX_SEG_MAX=10
CONFIG_BT_MESH_RX_SEG_MAX=10
CONFIG_BT_MESH_TX_SEG_MSG_COUNT=2
CONFIG_BT_MESH_RX_SEG_MSG_COUNT=2
CONFIG_BT_MESH_PB_GATT=y
CONFIG_BT_MESH_PB_ADV=y
CONFIG_BT_MESH_GATT_PROXY=y
CONFIG_BT_MESH_SHELL=y
CONFIG_BT_MESH_DK_PROV=y
CONFIG_BT_MESH_PROXY_USE_DEVICE_NAME=y

# Bluetooth mesh models
CONFIG_BT_MESH_BLOB_SRV=y
CONFIG_BT_MESH_BLOB_IO_FLASH=y
CONFIG_BT_MESH_BLOB_CLI=y
CONFIG_BT_MESH_DFU_SRV=y
CONFIG_BT_MESH_DFU_METADATA=y
CONFIG_BT_MESH_DFU_CLI=y
CONFIG_BT_MESH_DFD_SRV=y
CONFIG_BT_MESH_SAR_CFG_SRV=n

# Reconfigure transport SAR for DFU
# Increase probability of delivering segmented messages
CONFIG_BT_MESH_SAR_TX_UNICAST_RETRANS_COUNT=0x5
CONFIG_BT_MESH_SAR_TX_UNICAST_RETRANS_WITHOUT_PROG_COUNT=0x3
# Reduce amount of generated SegAcks
CONFIG_BT_MESH_SAR_RX_ACK_RETRANS_COUNT=0x0
CONFIG_BT_MESH_SAR_RX_ACK_DELAY_INC=0x7
CONFIG_BT_MESH_SAR_RX_SEG_INT_STEP=0xf
CONFIG_BT_MESH_SAR_RX_SEG_THRESHOLD=0x1f

# Debug configuration
CONFIG_BT_MESH_LOG_LEVEL_DBG=n
CONFIG_BT_MESH_MODEL_LOG_LEVEL_DBG=n
CONFIG_BT_MESH_DFU_LOG_LEVEL_DBG=n
CONFIG_BT_MESH_PROV_DEVICE_LOG_LEVEL_INF=y

# Additional simultaneous connections for SMP BT.
#CONFIG_BT_MAX_CONN=2
#CONFIG_BT_CTLR_ADV_SET=3
#CONFIG_BT_EXT_ADV_MAX_ADV_SET=3

CONFIG_HWINFO=y


CONFIG_DEBUG_THREAD_INFO=y
```

## overlay-cloud_mqtt.conf
```kconfig
#
# Copyright (c) 2021 Nordic Semiconductor
#
# SPDX-License-Identifier: LicenseRef-Nordic-5-Clause
#

# Modem Shell
CONFIG_MOSH_CLOUD_MQTT=y
CONFIG_MOSH_CLOUD_REST=n

# Report standard information to shadow
CONFIG_NRF_CLOUD_SEND_DEVICE_STATUS=y
CONFIG_NRF_CLOUD_SEND_DEVICE_STATUS_NETWORK=y
CONFIG_NRF_CLOUD_SEND_DEVICE_STATUS_SIM=y


CONFIG_STREAM_FLASH=y
CONFIG_STREAM_FLASH_ERASE=y

CONFIG_IMG_MANAGER=y
CONFIG_BOOTLOADER_MCUBOOT=y

CONFIG_SHELL_BACKEND_DUMMY=y

CONFIG_FOTA_CLIENT_AUTOSCHEDULE_UPDATE=n
```

## prj_dfu.conf
```kconfig
# CONFIG_NET_IPV6 is not set
CONFIG_PINCTRL=y
CONFIG_HEAP_MEM_POOL_SIZE=8192
CONFIG_PM_DEVICE=y
CONFIG_MAIN_STACK_SIZE=4096
CONFIG_SYSTEM_WORKQUEUE_STACK_SIZE=2048
CONFIG_DFU_TARGET_STREAM_SAVE_PROGRESS=y
CONFIG_NRF_CLOUD_FOTA_LOG_LEVEL_DBG=y
CONFIG_NRF_CLOUD_AGNSS=y
CONFIG_NRF_CLOUD_SEND_DEVICE_STATUS_NETWORK=y
CONFIG_NRF_CLOUD_SEND_DEVICE_STATUS_SIM=y
CONFIG_NRF_CLOUD_LOG_LEVEL_DBG=y
CONFIG_MBEDTLS_MPI_MAX_SIZE=256
CONFIG_POSIX_MAX_FDS=10
CONFIG_NET_SOCKETS_POLL_MAX=10
CONFIG_NRF_MODEM_LIB_SHMEM_TX_SIZE=22528
CONFIG_NRF_MODEM_LIB_ON_FAULT_APPLICATION_SPECIFIC=y
CONFIG_AT_MONITOR_HEAP_SIZE=1024
CONFIG_LTE_LINK_CONTROL=y
# CONFIG_LTE_SHELL is not set
CONFIG_LTE_NETWORK_MODE_DEFAULT=y
CONFIG_LTE_LC_TAU_PRE_WARNING_THRESHOLD_MS=10240
CONFIG_LTE_NEIGHBOR_CELLS_MAX=17
CONFIG_LTE_LC_MODEM_SLEEP_NOTIFICATIONS_THRESHOLD_MS=10240
CONFIG_DK_LIBRARY=y
CONFIG_MODEM_INFO=y
CONFIG_PDN=y
CONFIG_PDN_ESM_STRERROR=y
# CONFIG_RESET_ON_FATAL_ERROR is not set
CONFIG_SMS=y
CONFIG_MODEM_KEY_MGMT=y
CONFIG_DATE_TIME=y
CONFIG_NRFX_GPIOTE_NUM_OF_EVT_HANDLERS=1
CONFIG_GETOPT_LIB=y
CONFIG_BOOTLOADER_MCUBOOT=y
CONFIG_TFM_SPM_LOG_LEVEL_DEBUG=y
CONFIG_TFM_SECURE_UART0=y
# CONFIG_TFM_HW_INIT_RESET_ON_BOOT is not set
CONFIG_BOARD_NRF9160DK_NRF9160_NS=y
CONFIG_SOC_SERIES_NRF91X=y
CONFIG_ARM_TRUSTZONE_M=y
CONFIG_ARM_MPU=y
CONFIG_TRUSTED_EXECUTION_NONSECURE=y
CONFIG_HW_STACK_PROTECTION=y
CONFIG_EXTRA_EXCEPTION_INFO=y
CONFIG_CONSOLE=y
CONFIG_UART_CONSOLE=y
CONFIG_FLASH=y
CONFIG_NEWLIB_LIBC=y
CONFIG_NEWLIB_LIBC_FLOAT_SCANF=y
CONFIG_SYS_HEAP_RUNTIME_STATS=y
CONFIG_POSIX_API=y
# CONFIG_PTHREAD_IPC is not set
CONFIG_ASSERT=y
CONFIG_DEBUG_INFO=y
CONFIG_IMG_MANAGER=y
CONFIG_NVS=y
CONFIG_NVS_LOG_LEVEL_WRN=y
CONFIG_LOG=y
# CONFIG_LOG_PRINTK is not set
CONFIG_NETWORKING=y
# CONFIG_NET_NATIVE is not set
CONFIG_NET_MAX_ROUTERS=1
CONFIG_SHELL=y
CONFIG_SHELL_PROMPT_UART="mosh:~$ "
CONFIG_SHELL_BACKEND_SERIAL_RX_RING_BUFFER_SIZE=512
CONFIG_SHELL_BACKEND_DUMMY=y
CONFIG_SHELL_STACK_SIZE=9216
CONFIG_SHELL_CMD_BUFF_SIZE=3584
CONFIG_SHELL_ARGC_MAX=40
# CONFIG_SHELL_WILDCARD is not set
# CONFIG_SHELL_HELP_OPT_PARSE is not set
# CONFIG_DEVMEM_SHELL is not set
CONFIG_FLASH_MAP=y
CONFIG_STREAM_FLASH=y
CONFIG_STREAM_FLASH_ERASE=y
# CONFIG_BUILD_OUTPUT_META is not set
# CONFIG_MOSH_CLOUD_REST is not set
CONFIG_MOSH_CLOUD_MQTT=y
```

## src/main.c
```c
/*
 * Copyright (c) 2020 Nordic Semiconductor ASA
 *
 * SPDX-License-Identifier: LicenseRef-Nordic-5-Clause
 */

#include <stdio.h>
#include <string.h>

#include <zephyr/kernel.h>
#include <zephyr/init.h>
#include <helpers/nrfx_reset_reason.h>
#include <nrf_modem.h>

#include <sys/types.h>
#include <zephyr/logging/log_ctrl.h>
#include <zephyr/sys/reboot.h>
#include <zephyr/dfu/mcuboot.h>

#include <zephyr/shell/shell.h>
#if defined(CONFIG_SHELL_BACKEND_SERIAL)
#include <zephyr/shell/shell_uart.h>
#else
#include <zephyr/shell/shell_rtt.h>
#endif

#include <modem/nrf_modem_lib.h>
#include <modem/at_monitor.h>
#include <modem/modem_info.h>
#include <modem/lte_lc.h>

#include <net/nrf_cloud_os.h>

#include <dk_buttons_and_leds.h>
#include "uart/uart_shell.h"

#if defined(CONFIG_MOSH_PPP)
#include "ppp_ctrl.h"
#endif

#if defined(CONFIG_MOSH_LINK)
#include "link.h"
#endif

#if defined(CONFIG_MOSH_GNSS)
#include "gnss.h"
#endif

#if defined(CONFIG_MOSH_FOTA)
#include "fota.h"
#endif
#if defined(CONFIG_MOSH_WORKER_THREADS)
#include "th/th_ctrl.h"
#endif
#include "mosh_defines.h"
#include "mosh_print.h"

#if defined(CONFIG_MOSH_LOCATION)
#include "location_shell.h"
#endif

#if defined(CONFIG_MOSH_STARTUP_CMDS)
#include "startup_cmd_ctrl.h"
#endif

#if defined(CONFIG_MOSH_AT_CMD_MODE)
#include "at_cmd_mode.h"
#include "at_cmd_mode_sett.h"
#endif

BUILD_ASSERT(IS_ENABLED(CONFIG_SHELL_BACKEND_SERIAL) || IS_ENABLED(CONFIG_SHELL_BACKEND_RTT),
	     "CONFIG_SHELL_BACKEND_SERIAL or CONFIG_SHELL_BACKEND_RTT shell backend must be "
	     "enabled");

/***** Work queue and work item definitions *****/

#define MOSH_COMMON_WORKQ_PRIORITY CONFIG_MOSH_COMMON_WORKQUEUE_PRIORITY
K_THREAD_STACK_DEFINE(mosh_common_workq_stack, CONFIG_MOSH_COMMON_WORKQUEUE_STACK_SIZE);
struct k_work_q mosh_common_work_q;

/* Global variables */
const struct shell *mosh_shell;
struct k_poll_signal mosh_signal;

char mosh_at_resp_buf[MOSH_AT_CMD_RESPONSE_MAX_LEN];
K_MUTEX_DEFINE(mosh_at_resp_buf_mutex);

static const char *modem_crash_reason_get(uint32_t reason)
{
	switch (reason) {
	case NRF_MODEM_FAULT_UNDEFINED:
		return "Undefined fault";

	case NRF_MODEM_FAULT_HW_WD_RESET:
		return "HW WD reset";

	case NRF_MODEM_FAULT_HARDFAULT:
		return "Hard fault";

	case NRF_MODEM_FAULT_MEM_MANAGE:
		return "Memory management fault";

	case NRF_MODEM_FAULT_BUS:
		return "Bus fault";

	case NRF_MODEM_FAULT_USAGE:
		return "Usage fault";

	case NRF_MODEM_FAULT_SECURE_RESET:
		return "Secure control reset";

	case NRF_MODEM_FAULT_PANIC_DOUBLE:
		return "Error handler crash";

	case NRF_MODEM_FAULT_PANIC_RESET_LOOP:
		return "Reset loop";

	case NRF_MODEM_FAULT_ASSERT:
		return "Assert";

	case NRF_MODEM_FAULT_PANIC:
		return "Unconditional SW reset";

	case NRF_MODEM_FAULT_FLASH_ERASE:
		return "Flash erase fault";

	case NRF_MODEM_FAULT_FLASH_WRITE:
		return "Flash write fault";

	case NRF_MODEM_FAULT_POFWARN:
		return "Undervoltage fault";

	case NRF_MODEM_FAULT_THWARN:
		return "Overtemperature fault";

	default:
		return "Unknown reason";
	}
}

void nrf_modem_fault_handler(struct nrf_modem_fault_info *fault_info)
{
	printk("Modem crash reason: 0x%x (%s), PC: 0x%x\n",
		fault_info->reason,
		modem_crash_reason_get(fault_info->reason),
		fault_info->program_counter);

	__ASSERT(false, "Modem crash detected, halting application execution");
}

static void reset_reason_str_get(char *str, uint32_t reason)
{
	size_t len;

	*str = '\0';

	if (reason & NRFX_RESET_REASON_RESETPIN_MASK) {
		(void)strcat(str, "PIN reset | ");
	}
	if (reason & NRFX_RESET_REASON_DOG_MASK) {
		(void)strcat(str, "watchdog | ");
	}
	if (reason & NRFX_RESET_REASON_OFF_MASK) {
		(void)strcat(str, "wakeup from power-off | ");
	}
	if (reason & NRFX_RESET_REASON_DIF_MASK) {
		(void)strcat(str, "debug interface wakeup | ");
	}
	if (reason & NRFX_RESET_REASON_SREQ_MASK) {
		(void)strcat(str, "software | ");
	}
	if (reason & NRFX_RESET_REASON_LOCKUP_MASK) {
		(void)strcat(str, "CPU lockup | ");
	}
	if (reason & NRFX_RESET_REASON_CTRLAP_MASK) {
		(void)strcat(str, "control access port | ");
	}

	len = strlen(str);
	if (len == 0) {
		(void)strcpy(str, "power-on reset");
	} else {
		str[len - 3] = '\0';
	}
}

static void mosh_print_reset_reason(void)
{
	uint32_t reset_reason;
	char reset_reason_str[128];

	/* Read RESETREAS register value and clear current reset reason(s). */
	reset_reason = nrfx_reset_reason_get();
	nrfx_reset_reason_clear(reset_reason);

	reset_reason_str_get(reset_reason_str, reset_reason);

	printk("\nReset reason: %s\n", reset_reason_str);
}

#if defined(CONFIG_DK_LIBRARY)
static void button_handler(uint32_t button_states, uint32_t has_changed)
{
	if (has_changed & button_states & DK_BTN1_MSK) {
		mosh_print("Button 1 pressed - raising a kill signal");
		k_poll_signal_raise(&mosh_signal, MOSH_SIGNAL_KILL);
#if defined(CONFIG_MOSH_WORKER_THREADS)
		th_ctrl_kill_em_all();
#endif
	} else if (has_changed & ~button_states & DK_BTN1_MSK) {
		mosh_print("Button 1 released - resetting a kill signal");
		k_poll_signal_reset(&mosh_signal);
	}

	if (has_changed & button_states & DK_BTN2_MSK) {
		/* printk() used instead of mosh_print() which returns before the printing is
		 * actually finished and UART gets shut down in the meantime causing a jam.
		 */
		printk("\nButton 2 pressed, toggling UART power state\n");
		uart_toggle_power_state();
	}
}
#endif

extern int mesh_dfu_main(void (*bt_ready)(void));
extern int mesh_dfu_start(void);

static K_SEM_DEFINE(bt_ready_sem, 0, 1);

static void bt_ready(void)
{
	printk("bt_ready\n");
	k_sem_give(&bt_ready_sem);
}

int main(void)
{
	int err;
	struct k_work_queue_config cfg = {
		.name = "mosh_common_workq",
	};

#if defined(CONFIG_SHELL_BACKEND_SERIAL)
	mosh_shell = shell_backend_uart_get_ptr();
#else
	mosh_shell = shell_backend_rtt_get_ptr();
#endif

	__ASSERT(mosh_shell != NULL, "Failed to get shell backend");

	mosh_print_reset_reason();

	mosh_print_version_info();

#if defined(CONFIG_NRF_CLOUD_REST) || defined(CONFIG_NRF_CLOUD_MQTT)
#if defined(CONFIG_MOSH_IPERF3)
	/* Due to iperf3, we cannot let nrf cloud lib to initialize cJSON lib to be
	 * using kernel heap allocations (i.e. k_ prepending functions).
	 * Thus, we use standard c alloc/free, i.e. "system heap".
	 */
	struct nrf_cloud_os_mem_hooks hooks = {
		.malloc_fn = malloc,
		.calloc_fn = calloc,
		.free_fn = free,
	};
#else
	/* else: we default to Kernel heap */
	struct nrf_cloud_os_mem_hooks hooks = {
		.malloc_fn = k_malloc,
		.calloc_fn = k_calloc,
		.free_fn = k_free,
	};
#endif

	nrf_cloud_os_mem_hooks_init(&hooks);
#endif

	k_work_queue_start(
		&mosh_common_work_q,
		mosh_common_workq_stack,
		K_THREAD_STACK_SIZEOF(mosh_common_workq_stack),
		MOSH_COMMON_WORKQ_PRIORITY,
		&cfg);

	err = nrf_modem_lib_init();
	if (err) {
		/* Modem library initialization failed. */
		printk("Could not initialize nrf_modem_lib, err %d\n", err);
		printk("Fatal error\n");
		return 0;
	}

#if defined(CONFIG_MOSH_PPP)
	ppp_ctrl_init();
#endif
#if defined(CONFIG_MOSH_WORKER_THREADS)
	th_ctrl_init();
#endif
#if defined(CONFIG_MOSH_FOTA)
	err = fota_init();
	if (err) {
		printk("Could not initialize FOTA: %d\n", err);
	}
#endif

#if defined(CONFIG_MOSH_LOCATION)
	/* Location library should be initialized before LTE normal mode */
	location_ctrl_init();
#endif
#if defined(CONFIG_LTE_LINK_CONTROL) && defined(CONFIG_MOSH_LINK)
	link_init();
#else
	err = lte_lc_connect();
	if (err) {
		printk("Could not connect: %d\n", err);
	}
#endif

#if defined(CONFIG_MODEM_INFO)
	err = modem_info_init();
	if (err) {
		printk("Modem info could not be established: %d\n", err);
		return 0;
	}
#endif

#if defined(CONFIG_DK_LIBRARY)
	err = dk_buttons_init(button_handler);
	if (err) {
		printk("Failed to initialize DK buttons library, error: %d\n", err);
	}
	err = dk_leds_init();
	if (err) {
		printk("Cannot initialize LEDs (err: %d)\n", err);
	}
#endif

	mesh_dfu_main(bt_ready);

	/* Application started successfully, mark image as OK to prevent
	 * revert at next reboot.
	 */
#if defined(CONFIG_BOOTLOADER_MCUBOOT)
	boot_write_img_confirmed();
#endif
	k_poll_signal_init(&mosh_signal);

#if defined(CONFIG_SHELL_BACKEND_SERIAL)
	/* Resize terminal width and height of the shell to have proper command editing. */
	shell_execute_cmd(mosh_shell, "resize");
#endif

#if defined(CONFIG_MOSH_STARTUP_CMDS)
	startup_cmd_ctrl_init();
#endif

#if defined(CONFIG_MOSH_AT_CMD_MODE)
	at_cmd_mode_sett_init();
	if (at_cmd_mode_sett_is_autostart_enabled()) {
		/* Start directly in AT cmd mode */
		at_cmd_mode_start(mosh_shell);
	}
#endif

	err = k_sem_take(&bt_ready_sem, K_FOREVER);
	if (err) {
		printk("bt_ready_sem err: %d", err);
	}

	printk("loading settings'n");

	err = settings_load();
	if (err) {
		mosh_error("Cannot load settings %d", err);
		return err;
	}

	mesh_dfu_start();

	return 0;
}
```
